// SPDX-License-Identifier: GPL-2.0+ OR MIT
/*
 * PMGR power domains for the Apple t6050 "M5 Max" SoC - DRAFT, never booted.
 *
 * Generated by gen_t6050_dt.py from the ADT /arm-io/pmgr `devices` table
 * (661 records, u16 ids, address mode ps-groups) using the record layout documented in
 * m1n1 proxyclient/m1n1/adt.py.  Emitted: 188 domains.  Skipped: 338 virtual
 * (no_ps) devices and 135 CPU/fabric/memory-controller domains (as in Asahi's
 * t8132-pmgr.dtsi).  Parents that are virtual or skipped are replaced by their
 * nearest emitted ancestors.  apple,always-on = ADT `critical` flag or an
 * override (commented).  First boots should use pd_ignore_unused.
 */

&pmgr {
	ps_aic: power-controller@108 {
		compatible = "apple,t6050-pmgr-pwrstate", "apple,t8103-pmgr-pwrstate";
		reg = <0x108 4>;
		#power-domain-cells = <0>;
		#reset-cells = <0>;
		label = "aic";
		apple,always-on; /* core device */
	};

	ps_pmc: power-controller@110 {
		compatible = "apple,t6050-pmgr-pwrstate", "apple,t8103-pmgr-pwrstate";
		reg = <0x110 4>;
		#power-domain-cells = <0>;
		#reset-cells = <0>;
		label = "pmc";
		apple,always-on; /* ADT critical */
	};

	ps_pms_c1ppt: power-controller@118 {
		compatible = "apple,t6050-pmgr-pwrstate", "apple,t8103-pmgr-pwrstate";
		reg = <0x118 4>;
		#power-domain-cells = <0>;
		#reset-cells = <0>;
		label = "pms_c1ppt";
		apple,always-on; /* ADT critical */
	};

	ps_soc_dpe: power-controller@120 {
		compatible = "apple,t6050-pmgr-pwrstate", "apple,t8103-pmgr-pwrstate";
		reg = <0x120 4>;
		#power-domain-cells = <0>;
		#reset-cells = <0>;
		label = "soc_dpe";
		apple,always-on; /* ADT critical */
	};

	ps_pmp: power-controller@128 {
		compatible = "apple,t6050-pmgr-pwrstate", "apple,t8103-pmgr-pwrstate";
		reg = <0x128 4>;
		#power-domain-cells = <0>;
		#reset-cells = <0>;
		label = "pmp";
		apple,always-on; /* ADT critical */
	};

	ps_pms_sram: power-controller@130 {
		compatible = "apple,t6050-pmgr-pwrstate", "apple,t8103-pmgr-pwrstate";
		reg = <0x130 4>;
		#power-domain-cells = <0>;
		#reset-cells = <0>;
		label = "pms_sram";
		apple,always-on; /* ADT critical */
	};

	ps_dispext0_sys: power-controller@200 {
		compatible = "apple,t6050-pmgr-pwrstate", "apple,t8103-pmgr-pwrstate";
		reg = <0x200 4>;
		#power-domain-cells = <0>;
		#reset-cells = <0>;
		label = "dispext0_sys";
	};

	ps_atc0_common: power-controller@208 {
		compatible = "apple,t6050-pmgr-pwrstate", "apple,t8103-pmgr-pwrstate";
		reg = <0x208 4>;
		#power-domain-cells = <0>;
		#reset-cells = <0>;
		label = "atc0_common";
	};

	ps_atc1_common: power-controller@210 {
		compatible = "apple,t6050-pmgr-pwrstate", "apple,t8103-pmgr-pwrstate";
		reg = <0x210 4>;
		#power-domain-cells = <0>;
		#reset-cells = <0>;
		label = "atc1_common";
	};

	ps_dispext2_sys: power-controller@220 {
		compatible = "apple,t6050-pmgr-pwrstate", "apple,t8103-pmgr-pwrstate";
		reg = <0x220 4>;
		#power-domain-cells = <0>;
		#reset-cells = <0>;
		label = "dispext2_sys";
	};

	ps_dispext3_sys: power-controller@228 {
		compatible = "apple,t6050-pmgr-pwrstate", "apple,t8103-pmgr-pwrstate";
		reg = <0x228 4>;
		#power-domain-cells = <0>;
		#reset-cells = <0>;
		label = "dispext3_sys";
	};

	ps_dispext1_sys: power-controller@230 {
		compatible = "apple,t6050-pmgr-pwrstate", "apple,t8103-pmgr-pwrstate";
		reg = <0x230 4>;
		#power-domain-cells = <0>;
		#reset-cells = <0>;
		label = "dispext1_sys";
	};

	ps_atc2_common: power-controller@238 {
		compatible = "apple,t6050-pmgr-pwrstate", "apple,t8103-pmgr-pwrstate";
		reg = <0x238 4>;
		#power-domain-cells = <0>;
		#reset-cells = <0>;
		label = "atc2_common";
	};

	ps_atc3_common: power-controller@240 {
		compatible = "apple,t6050-pmgr-pwrstate", "apple,t8103-pmgr-pwrstate";
		reg = <0x240 4>;
		#power-domain-cells = <0>;
		#reset-cells = <0>;
		label = "atc3_common";
	};

	ps_auss: power-controller@248 {
		compatible = "apple,t6050-pmgr-pwrstate", "apple,t8103-pmgr-pwrstate";
		reg = <0x248 4>;
		#power-domain-cells = <0>;
		#reset-cells = <0>;
		label = "auss";
	};

	ps_gpio: power-controller@250 {
		compatible = "apple,t6050-pmgr-pwrstate", "apple,t8103-pmgr-pwrstate";
		reg = <0x250 4>;
		#power-domain-cells = <0>;
		#reset-cells = <0>;
		label = "gpio";
	};

	ps_msg: power-controller@258 {
		compatible = "apple,t6050-pmgr-pwrstate", "apple,t8103-pmgr-pwrstate";
		reg = <0x258 4>;
		#power-domain-cells = <0>;
		#reset-cells = <0>;
		label = "msg";
	};

	ps_ap_tmm: power-controller@260 {
		compatible = "apple,t6050-pmgr-pwrstate", "apple,t8103-pmgr-pwrstate";
		reg = <0x260 4>;
		#power-domain-cells = <0>;
		#reset-cells = <0>;
		label = "ap_tmm";
	};

	ps_dispext0_fe: power-controller@268 {
		compatible = "apple,t6050-pmgr-pwrstate", "apple,t8103-pmgr-pwrstate";
		reg = <0x268 4>;
		#power-domain-cells = <0>;
		#reset-cells = <0>;
		label = "dispext0_fe";
		power-domains = <&ps_dispext0_sys>;
	};

	ps_dispext0_adma: power-controller@270 {
		compatible = "apple,t6050-pmgr-pwrstate", "apple,t8103-pmgr-pwrstate";
		reg = <0x270 4>;
		#power-domain-cells = <0>;
		#reset-cells = <0>;
		label = "dispext0_adma";
		power-domains = <&ps_dispext0_sys>;
	};

	ps_dispext0_cpu: power-controller@278 {
		compatible = "apple,t6050-pmgr-pwrstate", "apple,t8103-pmgr-pwrstate";
		reg = <0x278 4>;
		#power-domain-cells = <0>;
		#reset-cells = <0>;
		label = "dispext0_cpu";
		power-domains = <&ps_dispext0_fe>;
		status = "disabled"; /* Locked on M4 (Asahi t8132), don't touch */
	};

	ps_atc0_cio: power-controller@280 {
		compatible = "apple,t6050-pmgr-pwrstate", "apple,t8103-pmgr-pwrstate";
		reg = <0x280 4>;
		#power-domain-cells = <0>;
		#reset-cells = <0>;
		label = "atc0_cio";
		power-domains = <&ps_atc0_common>;
	};

	ps_atc0_pcie: power-controller@288 {
		compatible = "apple,t6050-pmgr-pwrstate", "apple,t8103-pmgr-pwrstate";
		reg = <0x288 4>;
		#power-domain-cells = <0>;
		#reset-cells = <0>;
		label = "atc0_pcie";
		power-domains = <&ps_atc0_common>;
	};

	ps_atc1_cio: power-controller@290 {
		compatible = "apple,t6050-pmgr-pwrstate", "apple,t8103-pmgr-pwrstate";
		reg = <0x290 4>;
		#power-domain-cells = <0>;
		#reset-cells = <0>;
		label = "atc1_cio";
		power-domains = <&ps_atc1_common>;
	};

	ps_atc1_pcie: power-controller@298 {
		compatible = "apple,t6050-pmgr-pwrstate", "apple,t8103-pmgr-pwrstate";
		reg = <0x298 4>;
		#power-domain-cells = <0>;
		#reset-cells = <0>;
		label = "atc1_pcie";
		power-domains = <&ps_atc1_common>;
	};

	ps_dispext2_fe: power-controller@2a0 {
		compatible = "apple,t6050-pmgr-pwrstate", "apple,t8103-pmgr-pwrstate";
		reg = <0x2a0 4>;
		#power-domain-cells = <0>;
		#reset-cells = <0>;
		label = "dispext2_fe";
		power-domains = <&ps_dispext2_sys>;
	};

	ps_dispext2_adma: power-controller@2a8 {
		compatible = "apple,t6050-pmgr-pwrstate", "apple,t8103-pmgr-pwrstate";
		reg = <0x2a8 4>;
		#power-domain-cells = <0>;
		#reset-cells = <0>;
		label = "dispext2_adma";
		power-domains = <&ps_dispext2_sys>;
	};

	ps_dispext2_cpu: power-controller@2b0 {
		compatible = "apple,t6050-pmgr-pwrstate", "apple,t8103-pmgr-pwrstate";
		reg = <0x2b0 4>;
		#power-domain-cells = <0>;
		#reset-cells = <0>;
		label = "dispext2_cpu";
		power-domains = <&ps_dispext2_fe>;
		status = "disabled"; /* Locked on M4 (Asahi t8132), don't touch */
	};

	ps_dispext3_fe: power-controller@2b8 {
		compatible = "apple,t6050-pmgr-pwrstate", "apple,t8103-pmgr-pwrstate";
		reg = <0x2b8 4>;
		#power-domain-cells = <0>;
		#reset-cells = <0>;
		label = "dispext3_fe";
		power-domains = <&ps_dispext3_sys>;
	};

	ps_dispext3_adma: power-controller@2c0 {
		compatible = "apple,t6050-pmgr-pwrstate", "apple,t8103-pmgr-pwrstate";
		reg = <0x2c0 4>;
		#power-domain-cells = <0>;
		#reset-cells = <0>;
		label = "dispext3_adma";
		power-domains = <&ps_dispext3_sys>;
	};

	ps_dispext3_cpu: power-controller@2c8 {
		compatible = "apple,t6050-pmgr-pwrstate", "apple,t8103-pmgr-pwrstate";
		reg = <0x2c8 4>;
		#power-domain-cells = <0>;
		#reset-cells = <0>;
		label = "dispext3_cpu";
		power-domains = <&ps_dispext3_fe>;
		status = "disabled"; /* Locked on M4 (Asahi t8132), don't touch */
	};

	ps_dispext1_fe: power-controller@2d0 {
		compatible = "apple,t6050-pmgr-pwrstate", "apple,t8103-pmgr-pwrstate";
		reg = <0x2d0 4>;
		#power-domain-cells = <0>;
		#reset-cells = <0>;
		label = "dispext1_fe";
		power-domains = <&ps_dispext1_sys>;
	};

	ps_dispext1_adma: power-controller@2d8 {
		compatible = "apple,t6050-pmgr-pwrstate", "apple,t8103-pmgr-pwrstate";
		reg = <0x2d8 4>;
		#power-domain-cells = <0>;
		#reset-cells = <0>;
		label = "dispext1_adma";
		power-domains = <&ps_dispext1_sys>;
	};

	ps_dispext1_cpu: power-controller@2e0 {
		compatible = "apple,t6050-pmgr-pwrstate", "apple,t8103-pmgr-pwrstate";
		reg = <0x2e0 4>;
		#power-domain-cells = <0>;
		#reset-cells = <0>;
		label = "dispext1_cpu";
		power-domains = <&ps_dispext1_fe>;
		status = "disabled"; /* Locked on M4 (Asahi t8132), don't touch */
	};

	ps_atc2_cio: power-controller@2e8 {
		compatible = "apple,t6050-pmgr-pwrstate", "apple,t8103-pmgr-pwrstate";
		reg = <0x2e8 4>;
		#power-domain-cells = <0>;
		#reset-cells = <0>;
		label = "atc2_cio";
		power-domains = <&ps_atc2_common>;
	};

	ps_atc2_pcie: power-controller@2f0 {
		compatible = "apple,t6050-pmgr-pwrstate", "apple,t8103-pmgr-pwrstate";
		reg = <0x2f0 4>;
		#power-domain-cells = <0>;
		#reset-cells = <0>;
		label = "atc2_pcie";
		power-domains = <&ps_atc2_common>;
	};

	ps_atc3_cio: power-controller@2f8 {
		compatible = "apple,t6050-pmgr-pwrstate", "apple,t8103-pmgr-pwrstate";
		reg = <0x2f8 4>;
		#power-domain-cells = <0>;
		#reset-cells = <0>;
		label = "atc3_cio";
		power-domains = <&ps_atc3_common>;
	};

	ps_atc3_pcie: power-controller@300 {
		compatible = "apple,t6050-pmgr-pwrstate", "apple,t8103-pmgr-pwrstate";
		reg = <0x300 4>;
		#power-domain-cells = <0>;
		#reset-cells = <0>;
		label = "atc3_pcie";
		power-domains = <&ps_atc3_common>;
	};

	ps_atc0_cio_pcie: power-controller@338 {
		compatible = "apple,t6050-pmgr-pwrstate", "apple,t8103-pmgr-pwrstate";
		reg = <0x338 4>;
		#power-domain-cells = <0>;
		#reset-cells = <0>;
		label = "atc0_cio_pcie";
		power-domains = <&ps_atc0_cio>;
	};

	ps_atc0_cio_usb: power-controller@340 {
		compatible = "apple,t6050-pmgr-pwrstate", "apple,t8103-pmgr-pwrstate";
		reg = <0x340 4>;
		#power-domain-cells = <0>;
		#reset-cells = <0>;
		label = "atc0_cio_usb";
		power-domains = <&ps_atc0_cio>;
	};

	ps_atc0_cio_auss: power-controller@348 {
		compatible = "apple,t6050-pmgr-pwrstate", "apple,t8103-pmgr-pwrstate";
		reg = <0x348 4>;
		#power-domain-cells = <0>;
		#reset-cells = <0>;
		label = "atc0_cio_auss";
		power-domains = <&ps_atc0_cio>, <&ps_auss>;
	};

	ps_atc1_cio_pcie: power-controller@350 {
		compatible = "apple,t6050-pmgr-pwrstate", "apple,t8103-pmgr-pwrstate";
		reg = <0x350 4>;
		#power-domain-cells = <0>;
		#reset-cells = <0>;
		label = "atc1_cio_pcie";
		power-domains = <&ps_atc1_cio>;
	};

	ps_atc1_cio_usb: power-controller@358 {
		compatible = "apple,t6050-pmgr-pwrstate", "apple,t8103-pmgr-pwrstate";
		reg = <0x358 4>;
		#power-domain-cells = <0>;
		#reset-cells = <0>;
		label = "atc1_cio_usb";
		power-domains = <&ps_atc1_cio>;
	};

	ps_atc1_cio_auss: power-controller@360 {
		compatible = "apple,t6050-pmgr-pwrstate", "apple,t8103-pmgr-pwrstate";
		reg = <0x360 4>;
		#power-domain-cells = <0>;
		#reset-cells = <0>;
		label = "atc1_cio_auss";
		power-domains = <&ps_atc1_cio>, <&ps_auss>;
	};

	ps_atc2_cio_pcie: power-controller@3f8 {
		compatible = "apple,t6050-pmgr-pwrstate", "apple,t8103-pmgr-pwrstate";
		reg = <0x3f8 4>;
		#power-domain-cells = <0>;
		#reset-cells = <0>;
		label = "atc2_cio_pcie";
		power-domains = <&ps_atc2_cio>;
	};

	ps_atc2_cio_usb: power-controller@400 {
		compatible = "apple,t6050-pmgr-pwrstate", "apple,t8103-pmgr-pwrstate";
		reg = <0x400 4>;
		#power-domain-cells = <0>;
		#reset-cells = <0>;
		label = "atc2_cio_usb";
		power-domains = <&ps_atc2_cio>;
	};

	ps_atc2_cio_auss: power-controller@408 {
		compatible = "apple,t6050-pmgr-pwrstate", "apple,t8103-pmgr-pwrstate";
		reg = <0x408 4>;
		#power-domain-cells = <0>;
		#reset-cells = <0>;
		label = "atc2_cio_auss";
		power-domains = <&ps_atc2_cio>, <&ps_auss>;
	};

	ps_atc3_cio_pcie: power-controller@410 {
		compatible = "apple,t6050-pmgr-pwrstate", "apple,t8103-pmgr-pwrstate";
		reg = <0x410 4>;
		#power-domain-cells = <0>;
		#reset-cells = <0>;
		label = "atc3_cio_pcie";
		power-domains = <&ps_atc3_cio>;
	};

	ps_atc3_cio_usb: power-controller@418 {
		compatible = "apple,t6050-pmgr-pwrstate", "apple,t8103-pmgr-pwrstate";
		reg = <0x418 4>;
		#power-domain-cells = <0>;
		#reset-cells = <0>;
		label = "atc3_cio_usb";
		power-domains = <&ps_atc3_cio>;
	};

	ps_atc3_cio_auss: power-controller@420 {
		compatible = "apple,t6050-pmgr-pwrstate", "apple,t8103-pmgr-pwrstate";
		reg = <0x420 4>;
		#power-domain-cells = <0>;
		#reset-cells = <0>;
		label = "atc3_cio_auss";
		power-domains = <&ps_atc3_cio>, <&ps_auss>;
	};
};

&pmgr1 {
	ps_ispsens0: power-controller@100 {
		compatible = "apple,t6050-pmgr-pwrstate", "apple,t8103-pmgr-pwrstate";
		reg = <0x100 4>;
		#power-domain-cells = <0>;
		#reset-cells = <0>;
		label = "ispsens0";
	};

	ps_global_aux_hpd_0: power-controller@108 {
		compatible = "apple,t6050-pmgr-pwrstate", "apple,t8103-pmgr-pwrstate";
		reg = <0x108 4>;
		#power-domain-cells = <0>;
		#reset-cells = <0>;
		label = "global_aux_hpd_0";
	};

	ps_global_aux_hpd_1: power-controller@110 {
		compatible = "apple,t6050-pmgr-pwrstate", "apple,t8103-pmgr-pwrstate";
		reg = <0x110 4>;
		#power-domain-cells = <0>;
		#reset-cells = <0>;
		label = "global_aux_hpd_1";
	};

	ps_apcie_gp: power-controller@118 {
		compatible = "apple,t6050-pmgr-pwrstate", "apple,t8103-pmgr-pwrstate";
		reg = <0x118 4>;
		#power-domain-cells = <0>;
		#reset-cells = <0>;
		label = "apcie_gp";
	};

	ps_apcie_st0: power-controller@128 {
		compatible = "apple,t6050-pmgr-pwrstate", "apple,t8103-pmgr-pwrstate";
		reg = <0x128 4>;
		#power-domain-cells = <0>;
		#reset-cells = <0>;
		label = "apcie_st0";
	};

	ps_apcie_st1: power-controller@130 {
		compatible = "apple,t6050-pmgr-pwrstate", "apple,t8103-pmgr-pwrstate";
		reg = <0x130 4>;
		#power-domain-cells = <0>;
		#reset-cells = <0>;
		label = "apcie_st1";
	};

	ps_ans: power-controller@140 {
		compatible = "apple,t6050-pmgr-pwrstate", "apple,t8103-pmgr-pwrstate";
		reg = <0x140 4>;
		#power-domain-cells = <0>;
		#reset-cells = <0>;
		label = "ans";
		apple,always-on; /* Asahi t8132: device reboots after 3-5 min if disabled */
	};

	ps_apcie_sys_gp: power-controller@148 {
		compatible = "apple,t6050-pmgr-pwrstate", "apple,t8103-pmgr-pwrstate";
		reg = <0x148 4>;
		#power-domain-cells = <0>;
		#reset-cells = <0>;
		label = "apcie_sys_gp";
		power-domains = <&ps_apcie_gp>;
	};

	ps_apcie_sys_st0: power-controller@150 {
		compatible = "apple,t6050-pmgr-pwrstate", "apple,t8103-pmgr-pwrstate";
		reg = <0x150 4>;
		#power-domain-cells = <0>;
		#reset-cells = <0>;
		label = "apcie_sys_st0";
		power-domains = <&ps_apcie_st0>, <&ps_ans>;
	};

	ps_apcie_sys_st1: power-controller@158 {
		compatible = "apple,t6050-pmgr-pwrstate", "apple,t8103-pmgr-pwrstate";
		reg = <0x158 4>;
		#power-domain-cells = <0>;
		#reset-cells = <0>;
		label = "apcie_sys_st1";
		power-domains = <&ps_apcie_st1>, <&ps_ans>;
	};

	ps_apcie_sys_gp_oc: power-controller@160 {
		compatible = "apple,t6050-pmgr-pwrstate", "apple,t8103-pmgr-pwrstate";
		reg = <0x160 4>;
		#power-domain-cells = <0>;
		#reset-cells = <0>;
		label = "apcie_sys_gp_oc";
		power-domains = <&ps_apcie_sys_gp>;
	};

	ps_apcie_sys_st0_o: power-controller@168 {
		compatible = "apple,t6050-pmgr-pwrstate", "apple,t8103-pmgr-pwrstate";
		reg = <0x168 4>;
		#power-domain-cells = <0>;
		#reset-cells = <0>;
		label = "apcie_sys_st0_o";
		power-domains = <&ps_apcie_sys_st0>;
	};

	ps_apcie_sys_st1_o: power-controller@170 {
		compatible = "apple,t6050-pmgr-pwrstate", "apple,t8103-pmgr-pwrstate";
		reg = <0x170 4>;
		#power-domain-cells = <0>;
		#reset-cells = <0>;
		label = "apcie_sys_st1_o";
		power-domains = <&ps_apcie_sys_st1>;
	};

	ps_disp_sys: power-controller@180 {
		compatible = "apple,t6050-pmgr-pwrstate", "apple,t8103-pmgr-pwrstate";
		reg = <0x180 4>;
		#power-domain-cells = <0>;
		#reset-cells = <0>;
		label = "disp_sys";
		apple,always-on; /* TODO: boot framebuffer; figure out if PM can be enabled */
	};

	ps_scodec: power-controller@190 {
		compatible = "apple,t6050-pmgr-pwrstate", "apple,t8103-pmgr-pwrstate";
		reg = <0x190 4>;
		#power-domain-cells = <0>;
		#reset-cells = <0>;
		label = "scodec";
	};

	ps_disp_fe: power-controller@198 {
		compatible = "apple,t6050-pmgr-pwrstate", "apple,t8103-pmgr-pwrstate";
		reg = <0x198 4>;
		#power-domain-cells = <0>;
		#reset-cells = <0>;
		label = "disp_fe";
		power-domains = <&ps_disp_sys>;
		apple,always-on; /* TODO: boot framebuffer; figure out if PM can be enabled */
	};

	ps_disp_adma: power-controller@1a0 {
		compatible = "apple,t6050-pmgr-pwrstate", "apple,t8103-pmgr-pwrstate";
		reg = <0x1a0 4>;
		#power-domain-cells = <0>;
		#reset-cells = <0>;
		label = "disp_adma";
		power-domains = <&ps_disp_sys>;
	};

	ps_disp_cpu: power-controller@1a8 {
		compatible = "apple,t6050-pmgr-pwrstate", "apple,t8103-pmgr-pwrstate";
		reg = <0x1a8 4>;
		#power-domain-cells = <0>;
		#reset-cells = <0>;
		label = "disp_cpu";
		power-domains = <&ps_disp_fe>;
		status = "disabled"; /* Locked on M4 (Asahi t8132), don't touch */
	};

	ps_apcie_phy_sw: power-controller@1b0 {
		compatible = "apple,t6050-pmgr-pwrstate", "apple,t8103-pmgr-pwrstate";
		reg = <0x1b0 4>;
		#power-domain-cells = <0>;
		#reset-cells = <0>;
		label = "apcie_phy_sw";
		power-domains = <&ps_apcie_sys_gp>;
	};

	ps_scodec_streaming: power-controller@1c0 {
		compatible = "apple,t6050-pmgr-pwrstate", "apple,t8103-pmgr-pwrstate";
		reg = <0x1c0 4>;
		#power-domain-cells = <0>;
		#reset-cells = <0>;
		label = "scodec_streaming";
		power-domains = <&ps_scodec>;
	};

	ps_aphy_st0_aus5_a: power-controller@240 {
		compatible = "apple,t6050-pmgr-pwrstate", "apple,t8103-pmgr-pwrstate";
		reg = <0x240 4>;
		#power-domain-cells = <0>;
		#reset-cells = <0>;
		label = "aphy_st0_aus5_a";
		power-domains = <&ps_apcie_phy_sw>;
	};

	ps_aphy_st1_aus5_a: power-controller@248 {
		compatible = "apple,t6050-pmgr-pwrstate", "apple,t8103-pmgr-pwrstate";
		reg = <0x248 4>;
		#power-domain-cells = <0>;
		#reset-cells = <0>;
		label = "aphy_st1_aus5_a";
		power-domains = <&ps_apcie_phy_sw>;
	};

	ps_aphy_gp_aus5_a: power-controller@258 {
		compatible = "apple,t6050-pmgr-pwrstate", "apple,t8103-pmgr-pwrstate";
		reg = <0x258 4>;
		#power-domain-cells = <0>;
		#reset-cells = <0>;
		label = "aphy_gp_aus5_a";
		power-domains = <&ps_apcie_phy_sw>;
	};

	ps_aphy_st0_aus5: power-controller@268 {
		compatible = "apple,t6050-pmgr-pwrstate", "apple,t8103-pmgr-pwrstate";
		reg = <0x268 4>;
		#power-domain-cells = <0>;
		#reset-cells = <0>;
		label = "aphy_st0_aus5";
		power-domains = <&ps_aphy_st0_aus5_a>;
	};

	ps_aphy_st1_aus5: power-controller@270 {
		compatible = "apple,t6050-pmgr-pwrstate", "apple,t8103-pmgr-pwrstate";
		reg = <0x270 4>;
		#power-domain-cells = <0>;
		#reset-cells = <0>;
		label = "aphy_st1_aus5";
		power-domains = <&ps_aphy_st1_aus5_a>;
	};

	ps_aphy_gp_aus5: power-controller@280 {
		compatible = "apple,t6050-pmgr-pwrstate", "apple,t8103-pmgr-pwrstate";
		reg = <0x280 4>;
		#power-domain-cells = <0>;
		#reset-cells = <0>;
		label = "aphy_gp_aus5";
		power-domains = <&ps_aphy_gp_aus5_a>;
	};

	ps_sio: power-controller@290 {
		compatible = "apple,t6050-pmgr-pwrstate", "apple,t8103-pmgr-pwrstate";
		reg = <0x290 4>;
		#power-domain-cells = <0>;
		#reset-cells = <0>;
		label = "sio";
		apple,always-on; /* ADT critical */
	};

	ps_sep: power-controller@298 {
		compatible = "apple,t6050-pmgr-pwrstate", "apple,t8103-pmgr-pwrstate";
		reg = <0x298 4>;
		#power-domain-cells = <0>;
		#reset-cells = <0>;
		label = "sep";
		apple,always-on; /* ADT critical */
	};

	ps_sio_cpu: power-controller@2a0 {
		compatible = "apple,t6050-pmgr-pwrstate", "apple,t8103-pmgr-pwrstate";
		reg = <0x2a0 4>;
		#power-domain-cells = <0>;
		#reset-cells = <0>;
		label = "sio_cpu";
		power-domains = <&ps_sio>;
		apple,always-on; /* ADT critical */
	};

	ps_fpwm0: power-controller@2a8 {
		compatible = "apple,t6050-pmgr-pwrstate", "apple,t8103-pmgr-pwrstate";
		reg = <0x2a8 4>;
		#power-domain-cells = <0>;
		#reset-cells = <0>;
		label = "fpwm0";
		power-domains = <&ps_sio>;
	};

	ps_fpwm2: power-controller@2b8 {
		compatible = "apple,t6050-pmgr-pwrstate", "apple,t8103-pmgr-pwrstate";
		reg = <0x2b8 4>;
		#power-domain-cells = <0>;
		#reset-cells = <0>;
		label = "fpwm2";
		power-domains = <&ps_sio>;
	};

	ps_i2c0: power-controller@2c0 {
		compatible = "apple,t6050-pmgr-pwrstate", "apple,t8103-pmgr-pwrstate";
		reg = <0x2c0 4>;
		#power-domain-cells = <0>;
		#reset-cells = <0>;
		label = "i2c0";
		power-domains = <&ps_sio>;
	};

	ps_i2c1: power-controller@2c8 {
		compatible = "apple,t6050-pmgr-pwrstate", "apple,t8103-pmgr-pwrstate";
		reg = <0x2c8 4>;
		#power-domain-cells = <0>;
		#reset-cells = <0>;
		label = "i2c1";
		power-domains = <&ps_sio>;
	};

	ps_i2c2: power-controller@2d0 {
		compatible = "apple,t6050-pmgr-pwrstate", "apple,t8103-pmgr-pwrstate";
		reg = <0x2d0 4>;
		#power-domain-cells = <0>;
		#reset-cells = <0>;
		label = "i2c2";
		power-domains = <&ps_sio>;
	};

	ps_i2c3: power-controller@2d8 {
		compatible = "apple,t6050-pmgr-pwrstate", "apple,t8103-pmgr-pwrstate";
		reg = <0x2d8 4>;
		#power-domain-cells = <0>;
		#reset-cells = <0>;
		label = "i2c3";
		power-domains = <&ps_sio>;
	};

	ps_i2c4: power-controller@2e0 {
		compatible = "apple,t6050-pmgr-pwrstate", "apple,t8103-pmgr-pwrstate";
		reg = <0x2e0 4>;
		#power-domain-cells = <0>;
		#reset-cells = <0>;
		label = "i2c4";
		power-domains = <&ps_sio>;
	};

	ps_i2c5: power-controller@2e8 {
		compatible = "apple,t6050-pmgr-pwrstate", "apple,t8103-pmgr-pwrstate";
		reg = <0x2e8 4>;
		#power-domain-cells = <0>;
		#reset-cells = <0>;
		label = "i2c5";
		power-domains = <&ps_sio>;
	};

	ps_i2c6: power-controller@2f0 {
		compatible = "apple,t6050-pmgr-pwrstate", "apple,t8103-pmgr-pwrstate";
		reg = <0x2f0 4>;
		#power-domain-cells = <0>;
		#reset-cells = <0>;
		label = "i2c6";
		power-domains = <&ps_sio>;
	};

	ps_i2c7: power-controller@2f8 {
		compatible = "apple,t6050-pmgr-pwrstate", "apple,t8103-pmgr-pwrstate";
		reg = <0x2f8 4>;
		#power-domain-cells = <0>;
		#reset-cells = <0>;
		label = "i2c7";
		power-domains = <&ps_sio>;
	};

	ps_i2c8: power-controller@300 {
		compatible = "apple,t6050-pmgr-pwrstate", "apple,t8103-pmgr-pwrstate";
		reg = <0x300 4>;
		#power-domain-cells = <0>;
		#reset-cells = <0>;
		label = "i2c8";
		power-domains = <&ps_sio>;
	};

	ps_spi_p: power-controller@308 {
		compatible = "apple,t6050-pmgr-pwrstate", "apple,t8103-pmgr-pwrstate";
		reg = <0x308 4>;
		#power-domain-cells = <0>;
		#reset-cells = <0>;
		label = "spi_p";
		power-domains = <&ps_sio>;
		apple,always-on; /* Asahi t8132 marks it always-on */
	};

	ps_uart_p: power-controller@310 {
		compatible = "apple,t6050-pmgr-pwrstate", "apple,t8103-pmgr-pwrstate";
		reg = <0x310 4>;
		#power-domain-cells = <0>;
		#reset-cells = <0>;
		label = "uart_p";
		power-domains = <&ps_sio>;
		apple,always-on; /* parent of uart0 (Asahi t8132 marks it always-on) */
	};

	ps_aes: power-controller@318 {
		compatible = "apple,t6050-pmgr-pwrstate", "apple,t8103-pmgr-pwrstate";
		reg = <0x318 4>;
		#power-domain-cells = <0>;
		#reset-cells = <0>;
		label = "aes";
		power-domains = <&ps_sio>;
	};

	ps_spi0: power-controller@320 {
		compatible = "apple,t6050-pmgr-pwrstate", "apple,t8103-pmgr-pwrstate";
		reg = <0x320 4>;
		#power-domain-cells = <0>;
		#reset-cells = <0>;
		label = "spi0";
		power-domains = <&ps_spi_p>;
	};

	ps_spi1: power-controller@328 {
		compatible = "apple,t6050-pmgr-pwrstate", "apple,t8103-pmgr-pwrstate";
		reg = <0x328 4>;
		#power-domain-cells = <0>;
		#reset-cells = <0>;
		label = "spi1";
		power-domains = <&ps_spi_p>;
	};

	ps_spi2: power-controller@330 {
		compatible = "apple,t6050-pmgr-pwrstate", "apple,t8103-pmgr-pwrstate";
		reg = <0x330 4>;
		#power-domain-cells = <0>;
		#reset-cells = <0>;
		label = "spi2";
		power-domains = <&ps_spi_p>;
	};

	ps_spi3: power-controller@338 {
		compatible = "apple,t6050-pmgr-pwrstate", "apple,t8103-pmgr-pwrstate";
		reg = <0x338 4>;
		#power-domain-cells = <0>;
		#reset-cells = <0>;
		label = "spi3";
		power-domains = <&ps_spi_p>;
	};

	ps_spi4: power-controller@340 {
		compatible = "apple,t6050-pmgr-pwrstate", "apple,t8103-pmgr-pwrstate";
		reg = <0x340 4>;
		#power-domain-cells = <0>;
		#reset-cells = <0>;
		label = "spi4";
		power-domains = <&ps_spi_p>;
	};

	ps_spi5: power-controller@348 {
		compatible = "apple,t6050-pmgr-pwrstate", "apple,t8103-pmgr-pwrstate";
		reg = <0x348 4>;
		#power-domain-cells = <0>;
		#reset-cells = <0>;
		label = "spi5";
		power-domains = <&ps_spi_p>;
	};

	ps_qspi: power-controller@350 {
		compatible = "apple,t6050-pmgr-pwrstate", "apple,t8103-pmgr-pwrstate";
		reg = <0x350 4>;
		#power-domain-cells = <0>;
		#reset-cells = <0>;
		label = "qspi";
		power-domains = <&ps_spi_p>;
	};

	ps_uart_n: power-controller@358 {
		compatible = "apple,t6050-pmgr-pwrstate", "apple,t8103-pmgr-pwrstate";
		reg = <0x358 4>;
		#power-domain-cells = <0>;
		#reset-cells = <0>;
		label = "uart_n";
		power-domains = <&ps_uart_p>;
	};

	ps_uart0: power-controller@360 {
		compatible = "apple,t6050-pmgr-pwrstate", "apple,t8103-pmgr-pwrstate";
		reg = <0x360 4>;
		#power-domain-cells = <0>;
		#reset-cells = <0>;
		label = "uart0";
		power-domains = <&ps_uart_p>;
	};

	ps_uart1: power-controller@368 {
		compatible = "apple,t6050-pmgr-pwrstate", "apple,t8103-pmgr-pwrstate";
		reg = <0x368 4>;
		#power-domain-cells = <0>;
		#reset-cells = <0>;
		label = "uart1";
		power-domains = <&ps_uart_p>;
	};

	ps_uart2: power-controller@370 {
		compatible = "apple,t6050-pmgr-pwrstate", "apple,t8103-pmgr-pwrstate";
		reg = <0x370 4>;
		#power-domain-cells = <0>;
		#reset-cells = <0>;
		label = "uart2";
		power-domains = <&ps_uart_p>;
	};

	ps_uart3: power-controller@378 {
		compatible = "apple,t6050-pmgr-pwrstate", "apple,t8103-pmgr-pwrstate";
		reg = <0x378 4>;
		#power-domain-cells = <0>;
		#reset-cells = <0>;
		label = "uart3";
		power-domains = <&ps_uart_p>;
	};

	ps_uart4: power-controller@380 {
		compatible = "apple,t6050-pmgr-pwrstate", "apple,t8103-pmgr-pwrstate";
		reg = <0x380 4>;
		#power-domain-cells = <0>;
		#reset-cells = <0>;
		label = "uart4";
		power-domains = <&ps_uart_p>;
	};

	ps_uart5: power-controller@388 {
		compatible = "apple,t6050-pmgr-pwrstate", "apple,t8103-pmgr-pwrstate";
		reg = <0x388 4>;
		#power-domain-cells = <0>;
		#reset-cells = <0>;
		label = "uart5";
		power-domains = <&ps_uart_p>;
	};

	ps_uart6: power-controller@390 {
		compatible = "apple,t6050-pmgr-pwrstate", "apple,t8103-pmgr-pwrstate";
		reg = <0x390 4>;
		#power-domain-cells = <0>;
		#reset-cells = <0>;
		label = "uart6";
		power-domains = <&ps_uart_p>;
	};

	ps_isp_sys: power-controller@3a0 {
		compatible = "apple,t6050-pmgr-pwrstate", "apple,t8103-pmgr-pwrstate";
		reg = <0x3a0 4>;
		#power-domain-cells = <0>;
		#reset-cells = <0>;
		label = "isp_sys";
	};

	ps_ane_sys: power-controller@3a8 {
		compatible = "apple,t6050-pmgr-pwrstate", "apple,t8103-pmgr-pwrstate";
		reg = <0x3a8 4>;
		#power-domain-cells = <0>;
		#reset-cells = <0>;
		label = "ane_sys";
	};

	ps_ane_mpm: power-controller@3c0 {
		compatible = "apple,t6050-pmgr-pwrstate", "apple,t8103-pmgr-pwrstate";
		reg = <0x3c0 4>;
		#power-domain-cells = <0>;
		#reset-cells = <0>;
		label = "ane_mpm";
		power-domains = <&ps_ane_sys>;
	};

	ps_ane_cpu: power-controller@3c8 {
		compatible = "apple,t6050-pmgr-pwrstate", "apple,t8103-pmgr-pwrstate";
		reg = <0x3c8 4>;
		#power-domain-cells = <0>;
		#reset-cells = <0>;
		label = "ane_cpu";
		power-domains = <&ps_ane_sys>;
	};

	ps_ane_tdbase: power-controller@3d0 {
		compatible = "apple,t6050-pmgr-pwrstate", "apple,t8103-pmgr-pwrstate";
		reg = <0x3d0 4>;
		#power-domain-cells = <0>;
		#reset-cells = <0>;
		label = "ane_tdbase";
		power-domains = <&ps_ane_sys>;
	};
};

&pmgr_mini {
	ps_debug_gated: power-controller@58 {
		compatible = "apple,t6050-pmgr-pwrstate", "apple,t8103-pmgr-pwrstate";
		reg = <0x58 4>;
		#power-domain-cells = <0>;
		#reset-cells = <0>;
		label = "debug_gated";
		apple,always-on; /* ADT critical */
	};

	ps_nub_spmi_a0: power-controller@60 {
		compatible = "apple,t6050-pmgr-pwrstate", "apple,t8103-pmgr-pwrstate";
		reg = <0x60 4>;
		#power-domain-cells = <0>;
		#reset-cells = <0>;
		label = "nub_spmi_a0";
		apple,always-on; /* ADT critical */
	};

	ps_nub_spmi_a1: power-controller@68 {
		compatible = "apple,t6050-pmgr-pwrstate", "apple,t8103-pmgr-pwrstate";
		reg = <0x68 4>;
		#power-domain-cells = <0>;
		#reset-cells = <0>;
		label = "nub_spmi_a1";
		apple,always-on; /* ADT critical */
	};

	ps_nub_spmi_a2: power-controller@70 {
		compatible = "apple,t6050-pmgr-pwrstate", "apple,t8103-pmgr-pwrstate";
		reg = <0x70 4>;
		#power-domain-cells = <0>;
		#reset-cells = <0>;
		label = "nub_spmi_a2";
		apple,always-on; /* ADT critical */
	};

	ps_nub_dock_channel: power-controller@80 {
		compatible = "apple,t6050-pmgr-pwrstate", "apple,t8103-pmgr-pwrstate";
		reg = <0x80 4>;
		#power-domain-cells = <0>;
		#reset-cells = <0>;
		label = "nub_dock_channel";
		apple,always-on; /* ADT critical */
	};

	ps_nub_gpio: power-controller@88 {
		compatible = "apple,t6050-pmgr-pwrstate", "apple,t8103-pmgr-pwrstate";
		reg = <0x88 4>;
		#power-domain-cells = <0>;
		#reset-cells = <0>;
		label = "nub_gpio";
		apple,always-on; /* ADT critical */
	};

	ps_atc0_common_dp_0: power-controller@98 {
		compatible = "apple,t6050-pmgr-pwrstate", "apple,t8103-pmgr-pwrstate";
		reg = <0x98 4>;
		#power-domain-cells = <0>;
		#reset-cells = <0>;
		label = "atc0_common_dp_0";
	};

	ps_atc0_common_dp_1: power-controller@a0 {
		compatible = "apple,t6050-pmgr-pwrstate", "apple,t8103-pmgr-pwrstate";
		reg = <0xa0 4>;
		#power-domain-cells = <0>;
		#reset-cells = <0>;
		label = "atc0_common_dp_1";
	};

	ps_atc0_common_dp_2: power-controller@a8 {
		compatible = "apple,t6050-pmgr-pwrstate", "apple,t8103-pmgr-pwrstate";
		reg = <0xa8 4>;
		#power-domain-cells = <0>;
		#reset-cells = <0>;
		label = "atc0_common_dp_2";
	};

	ps_atc0_common_dp_3: power-controller@b0 {
		compatible = "apple,t6050-pmgr-pwrstate", "apple,t8103-pmgr-pwrstate";
		reg = <0xb0 4>;
		#power-domain-cells = <0>;
		#reset-cells = <0>;
		label = "atc0_common_dp_3";
	};

	ps_atc1_common_dp_0: power-controller@b8 {
		compatible = "apple,t6050-pmgr-pwrstate", "apple,t8103-pmgr-pwrstate";
		reg = <0xb8 4>;
		#power-domain-cells = <0>;
		#reset-cells = <0>;
		label = "atc1_common_dp_0";
	};

	ps_atc1_common_dp_1: power-controller@c0 {
		compatible = "apple,t6050-pmgr-pwrstate", "apple,t8103-pmgr-pwrstate";
		reg = <0xc0 4>;
		#power-domain-cells = <0>;
		#reset-cells = <0>;
		label = "atc1_common_dp_1";
	};

	ps_atc1_common_dp_2: power-controller@c8 {
		compatible = "apple,t6050-pmgr-pwrstate", "apple,t8103-pmgr-pwrstate";
		reg = <0xc8 4>;
		#power-domain-cells = <0>;
		#reset-cells = <0>;
		label = "atc1_common_dp_2";
	};

	ps_atc1_common_dp_3: power-controller@d0 {
		compatible = "apple,t6050-pmgr-pwrstate", "apple,t8103-pmgr-pwrstate";
		reg = <0xd0 4>;
		#power-domain-cells = <0>;
		#reset-cells = <0>;
		label = "atc1_common_dp_3";
	};

	ps_atc2_common_dp_0: power-controller@d8 {
		compatible = "apple,t6050-pmgr-pwrstate", "apple,t8103-pmgr-pwrstate";
		reg = <0xd8 4>;
		#power-domain-cells = <0>;
		#reset-cells = <0>;
		label = "atc2_common_dp_0";
	};

	ps_atc2_common_dp_1: power-controller@e0 {
		compatible = "apple,t6050-pmgr-pwrstate", "apple,t8103-pmgr-pwrstate";
		reg = <0xe0 4>;
		#power-domain-cells = <0>;
		#reset-cells = <0>;
		label = "atc2_common_dp_1";
	};

	ps_atc2_common_dp_2: power-controller@e8 {
		compatible = "apple,t6050-pmgr-pwrstate", "apple,t8103-pmgr-pwrstate";
		reg = <0xe8 4>;
		#power-domain-cells = <0>;
		#reset-cells = <0>;
		label = "atc2_common_dp_2";
	};

	ps_atc2_common_dp_3: power-controller@f0 {
		compatible = "apple,t6050-pmgr-pwrstate", "apple,t8103-pmgr-pwrstate";
		reg = <0xf0 4>;
		#power-domain-cells = <0>;
		#reset-cells = <0>;
		label = "atc2_common_dp_3";
	};

	ps_atc3_common_dp_0: power-controller@f8 {
		compatible = "apple,t6050-pmgr-pwrstate", "apple,t8103-pmgr-pwrstate";
		reg = <0xf8 4>;
		#power-domain-cells = <0>;
		#reset-cells = <0>;
		label = "atc3_common_dp_0";
	};

	ps_atc3_common_dp_1: power-controller@100 {
		compatible = "apple,t6050-pmgr-pwrstate", "apple,t8103-pmgr-pwrstate";
		reg = <0x100 4>;
		#power-domain-cells = <0>;
		#reset-cells = <0>;
		label = "atc3_common_dp_1";
	};

	ps_atc3_common_dp_2: power-controller@108 {
		compatible = "apple,t6050-pmgr-pwrstate", "apple,t8103-pmgr-pwrstate";
		reg = <0x108 4>;
		#power-domain-cells = <0>;
		#reset-cells = <0>;
		label = "atc3_common_dp_2";
	};

	ps_atc3_common_dp_3: power-controller@110 {
		compatible = "apple,t6050-pmgr-pwrstate", "apple,t8103-pmgr-pwrstate";
		reg = <0x110 4>;
		#power-domain-cells = <0>;
		#reset-cells = <0>;
		label = "atc3_common_dp_3";
	};

	ps_nub_spmi_ahb: power-controller@118 {
		compatible = "apple,t6050-pmgr-pwrstate", "apple,t8103-pmgr-pwrstate";
		reg = <0x118 4>;
		#power-domain-cells = <0>;
		#reset-cells = <0>;
		label = "nub_spmi_ahb";
		apple,always-on; /* ADT critical */
	};

	ps_nub_spmi0: power-controller@120 {
		compatible = "apple,t6050-pmgr-pwrstate", "apple,t8103-pmgr-pwrstate";
		reg = <0x120 4>;
		#power-domain-cells = <0>;
		#reset-cells = <0>;
		label = "nub_spmi0";
		power-domains = <&ps_nub_spmi_ahb>;
		apple,always-on; /* ADT critical */
	};

	ps_nub_spmi1: power-controller@128 {
		compatible = "apple,t6050-pmgr-pwrstate", "apple,t8103-pmgr-pwrstate";
		reg = <0x128 4>;
		#power-domain-cells = <0>;
		#reset-cells = <0>;
		label = "nub_spmi1";
		power-domains = <&ps_nub_spmi_ahb>;
		apple,always-on; /* ADT critical */
	};

	ps_nub_spmi2: power-controller@130 {
		compatible = "apple,t6050-pmgr-pwrstate", "apple,t8103-pmgr-pwrstate";
		reg = <0x130 4>;
		#power-domain-cells = <0>;
		#reset-cells = <0>;
		label = "nub_spmi2";
		power-domains = <&ps_nub_spmi_ahb>;
		apple,always-on; /* ADT critical */
	};

	ps_nub_spmi3: power-controller@138 {
		compatible = "apple,t6050-pmgr-pwrstate", "apple,t8103-pmgr-pwrstate";
		reg = <0x138 4>;
		#power-domain-cells = <0>;
		#reset-cells = <0>;
		label = "nub_spmi3";
		power-domains = <&ps_nub_spmi_ahb>;
		apple,always-on; /* ADT critical */
	};

	ps_nub_spmi4: power-controller@140 {
		compatible = "apple,t6050-pmgr-pwrstate", "apple,t8103-pmgr-pwrstate";
		reg = <0x140 4>;
		#power-domain-cells = <0>;
		#reset-cells = <0>;
		label = "nub_spmi4";
		power-domains = <&ps_nub_spmi_ahb>;
		apple,always-on; /* ADT critical */
	};

	ps_atc0_usb_aon: power-controller@148 {
		compatible = "apple,t6050-pmgr-pwrstate", "apple,t8103-pmgr-pwrstate";
		reg = <0x148 4>;
		#power-domain-cells = <0>;
		#reset-cells = <0>;
		label = "atc0_usb_aon";
	};

	ps_atc0_usb: power-controller@150 {
		compatible = "apple,t6050-pmgr-pwrstate", "apple,t8103-pmgr-pwrstate";
		reg = <0x150 4>;
		#power-domain-cells = <0>;
		#reset-cells = <0>;
		label = "atc0_usb";
		power-domains = <&ps_atc0_common>, <&ps_atc0_usb_aon>;
	};

	ps_atc0_phymxwrap: power-controller@158 {
		compatible = "apple,t6050-pmgr-pwrstate", "apple,t8103-pmgr-pwrstate";
		reg = <0x158 4>;
		#power-domain-cells = <0>;
		#reset-cells = <0>;
		label = "atc0_phymxwrap";
		power-domains = <&ps_atc0_common>, <&ps_atc0_usb_aon>;
	};

	ps_atc1_usb_aon: power-controller@160 {
		compatible = "apple,t6050-pmgr-pwrstate", "apple,t8103-pmgr-pwrstate";
		reg = <0x160 4>;
		#power-domain-cells = <0>;
		#reset-cells = <0>;
		label = "atc1_usb_aon";
	};

	ps_atc1_usb: power-controller@168 {
		compatible = "apple,t6050-pmgr-pwrstate", "apple,t8103-pmgr-pwrstate";
		reg = <0x168 4>;
		#power-domain-cells = <0>;
		#reset-cells = <0>;
		label = "atc1_usb";
		power-domains = <&ps_atc1_common>, <&ps_atc1_usb_aon>;
	};

	ps_atc1_phymxwrap: power-controller@170 {
		compatible = "apple,t6050-pmgr-pwrstate", "apple,t8103-pmgr-pwrstate";
		reg = <0x170 4>;
		#power-domain-cells = <0>;
		#reset-cells = <0>;
		label = "atc1_phymxwrap";
		power-domains = <&ps_atc1_common>, <&ps_atc1_usb_aon>;
	};

	ps_atc2_usb_aon: power-controller@178 {
		compatible = "apple,t6050-pmgr-pwrstate", "apple,t8103-pmgr-pwrstate";
		reg = <0x178 4>;
		#power-domain-cells = <0>;
		#reset-cells = <0>;
		label = "atc2_usb_aon";
	};

	ps_atc2_usb: power-controller@180 {
		compatible = "apple,t6050-pmgr-pwrstate", "apple,t8103-pmgr-pwrstate";
		reg = <0x180 4>;
		#power-domain-cells = <0>;
		#reset-cells = <0>;
		label = "atc2_usb";
		power-domains = <&ps_atc2_common>, <&ps_atc2_usb_aon>;
	};

	ps_atc2_phymxwrap: power-controller@188 {
		compatible = "apple,t6050-pmgr-pwrstate", "apple,t8103-pmgr-pwrstate";
		reg = <0x188 4>;
		#power-domain-cells = <0>;
		#reset-cells = <0>;
		label = "atc2_phymxwrap";
		power-domains = <&ps_atc2_common>, <&ps_atc2_usb_aon>;
	};

	ps_atc3_usb_aon: power-controller@190 {
		compatible = "apple,t6050-pmgr-pwrstate", "apple,t8103-pmgr-pwrstate";
		reg = <0x190 4>;
		#power-domain-cells = <0>;
		#reset-cells = <0>;
		label = "atc3_usb_aon";
	};

	ps_atc3_usb: power-controller@198 {
		compatible = "apple,t6050-pmgr-pwrstate", "apple,t8103-pmgr-pwrstate";
		reg = <0x198 4>;
		#power-domain-cells = <0>;
		#reset-cells = <0>;
		label = "atc3_usb";
		power-domains = <&ps_atc3_common>, <&ps_atc3_usb_aon>;
	};

	ps_atc3_phymxwrap: power-controller@1a0 {
		compatible = "apple,t6050-pmgr-pwrstate", "apple,t8103-pmgr-pwrstate";
		reg = <0x1a0 4>;
		#power-domain-cells = <0>;
		#reset-cells = <0>;
		label = "atc3_phymxwrap";
		power-domains = <&ps_atc3_common>, <&ps_atc3_usb_aon>;
	};

	ps_smc_i2cm0: power-controller@8028 {
		compatible = "apple,t6050-pmgr-pwrstate", "apple,t8103-pmgr-pwrstate";
		reg = <0x8028 4>;
		#power-domain-cells = <0>;
		#reset-cells = <0>;
		label = "smc_i2cm0";
	};

	ps_smc_i2cm1: power-controller@8030 {
		compatible = "apple,t6050-pmgr-pwrstate", "apple,t8103-pmgr-pwrstate";
		reg = <0x8030 4>;
		#power-domain-cells = <0>;
		#reset-cells = <0>;
		label = "smc_i2cm1";
	};

	ps_smc_i2cm2: power-controller@8038 {
		compatible = "apple,t6050-pmgr-pwrstate", "apple,t8103-pmgr-pwrstate";
		reg = <0x8038 4>;
		#power-domain-cells = <0>;
		#reset-cells = <0>;
		label = "smc_i2cm2";
	};

	ps_smc_i2cm3: power-controller@8040 {
		compatible = "apple,t6050-pmgr-pwrstate", "apple,t8103-pmgr-pwrstate";
		reg = <0x8040 4>;
		#power-domain-cells = <0>;
		#reset-cells = <0>;
		label = "smc_i2cm3";
	};

	ps_smc_i2cm4: power-controller@8048 {
		compatible = "apple,t6050-pmgr-pwrstate", "apple,t8103-pmgr-pwrstate";
		reg = <0x8048 4>;
		#power-domain-cells = <0>;
		#reset-cells = <0>;
		label = "smc_i2cm4";
	};

	ps_smc_i2cm5: power-controller@8050 {
		compatible = "apple,t6050-pmgr-pwrstate", "apple,t8103-pmgr-pwrstate";
		reg = <0x8050 4>;
		#power-domain-cells = <0>;
		#reset-cells = <0>;
		label = "smc_i2cm5";
	};

	ps_smc_i2cm6: power-controller@8058 {
		compatible = "apple,t6050-pmgr-pwrstate", "apple,t8103-pmgr-pwrstate";
		reg = <0x8058 4>;
		#power-domain-cells = <0>;
		#reset-cells = <0>;
		label = "smc_i2cm6";
	};
};

&pmgr_gfx {
	ps_gpx: power-controller@0 {
		compatible = "apple,t6050-pmgr-pwrstate", "apple,t8103-pmgr-pwrstate";
		reg = <0x0 4>;
		#power-domain-cells = <0>;
		#reset-cells = <0>;
		label = "gpx";
		apple,always-on; /* ADT critical */
	};

	ps_afr: power-controller@100 {
		compatible = "apple,t6050-pmgr-pwrstate", "apple,t8103-pmgr-pwrstate";
		reg = <0x100 4>;
		#power-domain-cells = <0>;
		#reset-cells = <0>;
		label = "afr";
		apple,always-on; /* ADT critical */
	};

	ps_cs: power-controller@108 {
		compatible = "apple,t6050-pmgr-pwrstate", "apple,t8103-pmgr-pwrstate";
		reg = <0x108 4>;
		#power-domain-cells = <0>;
		#reset-cells = <0>;
		label = "cs";
		power-domains = <&ps_afr>;
		apple,always-on; /* GPU-side fabric block, conservative HYPOTHESIS */
	};

	ps_gfx: power-controller@110 {
		compatible = "apple,t6050-pmgr-pwrstate", "apple,t8103-pmgr-pwrstate";
		reg = <0x110 4>;
		#power-domain-cells = <0>;
		#reset-cells = <0>;
		label = "gfx";
		power-domains = <&ps_afr>, <&ps_gpx>;
	};
};

&pmgr_die1 {
	ps_aic_gfx: power-controller@108 {
		compatible = "apple,t6050-pmgr-pwrstate", "apple,t8103-pmgr-pwrstate";
		reg = <0x108 4>;
		#power-domain-cells = <0>;
		#reset-cells = <0>;
		label = "aic_gfx";
		apple,always-on; /* core device (second die), HYPOTHESIS */
	};

	ps_pms_gfx_c1ppt: power-controller@110 {
		compatible = "apple,t6050-pmgr-pwrstate", "apple,t8103-pmgr-pwrstate";
		reg = <0x110 4>;
		#power-domain-cells = <0>;
		#reset-cells = <0>;
		label = "pms_gfx_c1ppt";
		apple,always-on; /* ADT critical */
	};

	ps_soc_dpe_gfx: power-controller@118 {
		compatible = "apple,t6050-pmgr-pwrstate", "apple,t8103-pmgr-pwrstate";
		reg = <0x118 4>;
		#power-domain-cells = <0>;
		#reset-cells = <0>;
		label = "soc_dpe_gfx";
		apple,always-on; /* ADT critical */
	};

	ps_venc0_sys: power-controller@1c0 {
		compatible = "apple,t6050-pmgr-pwrstate", "apple,t8103-pmgr-pwrstate";
		reg = <0x1c0 4>;
		#power-domain-cells = <0>;
		#reset-cells = <0>;
		label = "venc0_sys";
	};

	ps_msr0: power-controller@1c8 {
		compatible = "apple,t6050-pmgr-pwrstate", "apple,t8103-pmgr-pwrstate";
		reg = <0x1c8 4>;
		#power-domain-cells = <0>;
		#reset-cells = <0>;
		label = "msr0";
	};

	ps_jpg: power-controller@1d0 {
		compatible = "apple,t6050-pmgr-pwrstate", "apple,t8103-pmgr-pwrstate";
		reg = <0x1d0 4>;
		#power-domain-cells = <0>;
		#reset-cells = <0>;
		label = "jpg";
	};

	ps_avd_sys: power-controller@1d8 {
		compatible = "apple,t6050-pmgr-pwrstate", "apple,t8103-pmgr-pwrstate";
		reg = <0x1d8 4>;
		#power-domain-cells = <0>;
		#reset-cells = <0>;
		label = "avd_sys";
	};

	ps_prores: power-controller@1e0 {
		compatible = "apple,t6050-pmgr-pwrstate", "apple,t8103-pmgr-pwrstate";
		reg = <0x1e0 4>;
		#power-domain-cells = <0>;
		#reset-cells = <0>;
		label = "prores";
	};

	ps_venc1_sys: power-controller@1f0 {
		compatible = "apple,t6050-pmgr-pwrstate", "apple,t8103-pmgr-pwrstate";
		reg = <0x1f0 4>;
		#power-domain-cells = <0>;
		#reset-cells = <0>;
		label = "venc1_sys";
	};

	ps_msr1: power-controller@1f8 {
		compatible = "apple,t6050-pmgr-pwrstate", "apple,t8103-pmgr-pwrstate";
		reg = <0x1f8 4>;
		#power-domain-cells = <0>;
		#reset-cells = <0>;
		label = "msr1";
	};

	ps_msr0_ase_core: power-controller@200 {
		compatible = "apple,t6050-pmgr-pwrstate", "apple,t8103-pmgr-pwrstate";
		reg = <0x200 4>;
		#power-domain-cells = <0>;
		#reset-cells = <0>;
		label = "msr0_ase_core";
		power-domains = <&ps_msr0>;
	};

	ps_msr1_ase_core: power-controller@208 {
		compatible = "apple,t6050-pmgr-pwrstate", "apple,t8103-pmgr-pwrstate";
		reg = <0x208 4>;
		#power-domain-cells = <0>;
		#reset-cells = <0>;
		label = "msr1_ase_core";
		power-domains = <&ps_msr1>;
	};

	ps_venc0_dma: power-controller@8000 {
		compatible = "apple,t6050-pmgr-pwrstate", "apple,t8103-pmgr-pwrstate";
		reg = <0x8000 4>;
		#power-domain-cells = <0>;
		#reset-cells = <0>;
		label = "venc0_dma";
		power-domains = <&ps_venc0_sys>;
	};

	ps_venc0_pipe4: power-controller@8008 {
		compatible = "apple,t6050-pmgr-pwrstate", "apple,t8103-pmgr-pwrstate";
		reg = <0x8008 4>;
		#power-domain-cells = <0>;
		#reset-cells = <0>;
		label = "venc0_pipe4";
		power-domains = <&ps_venc0_dma>;
	};

	ps_venc0_pipe5: power-controller@8010 {
		compatible = "apple,t6050-pmgr-pwrstate", "apple,t8103-pmgr-pwrstate";
		reg = <0x8010 4>;
		#power-domain-cells = <0>;
		#reset-cells = <0>;
		label = "venc0_pipe5";
		power-domains = <&ps_venc0_dma>;
	};

	ps_venc0_me0: power-controller@8018 {
		compatible = "apple,t6050-pmgr-pwrstate", "apple,t8103-pmgr-pwrstate";
		reg = <0x8018 4>;
		#power-domain-cells = <0>;
		#reset-cells = <0>;
		label = "venc0_me0";
		power-domains = <&ps_venc0_dma>;
	};

	ps_venc0_me1: power-controller@8020 {
		compatible = "apple,t6050-pmgr-pwrstate", "apple,t8103-pmgr-pwrstate";
		reg = <0x8020 4>;
		#power-domain-cells = <0>;
		#reset-cells = <0>;
		label = "venc0_me1";
		power-domains = <&ps_venc0_me0>;
	};

	ps_venc1_dma: power-controller@8028 {
		compatible = "apple,t6050-pmgr-pwrstate", "apple,t8103-pmgr-pwrstate";
		reg = <0x8028 4>;
		#power-domain-cells = <0>;
		#reset-cells = <0>;
		label = "venc1_dma";
		power-domains = <&ps_venc1_sys>;
	};

	ps_venc1_pipe4: power-controller@8030 {
		compatible = "apple,t6050-pmgr-pwrstate", "apple,t8103-pmgr-pwrstate";
		reg = <0x8030 4>;
		#power-domain-cells = <0>;
		#reset-cells = <0>;
		label = "venc1_pipe4";
		power-domains = <&ps_venc1_dma>;
	};

	ps_venc1_pipe5: power-controller@8038 {
		compatible = "apple,t6050-pmgr-pwrstate", "apple,t8103-pmgr-pwrstate";
		reg = <0x8038 4>;
		#power-domain-cells = <0>;
		#reset-cells = <0>;
		label = "venc1_pipe5";
		power-domains = <&ps_venc1_dma>;
	};

	ps_venc1_me0: power-controller@8040 {
		compatible = "apple,t6050-pmgr-pwrstate", "apple,t8103-pmgr-pwrstate";
		reg = <0x8040 4>;
		#power-domain-cells = <0>;
		#reset-cells = <0>;
		label = "venc1_me0";
		power-domains = <&ps_venc1_dma>;
	};

	ps_venc1_me1: power-controller@8048 {
		compatible = "apple,t6050-pmgr-pwrstate", "apple,t8103-pmgr-pwrstate";
		reg = <0x8048 4>;
		#power-domain-cells = <0>;
		#reset-cells = <0>;
		label = "venc1_me1";
		power-domains = <&ps_venc1_me0>;
	};
};

&pmgr_die1_mini {
	ps_debug_gfx_gated: power-controller@58 {
		compatible = "apple,t6050-pmgr-pwrstate", "apple,t8103-pmgr-pwrstate";
		reg = <0x58 4>;
		#power-domain-cells = <0>;
		#reset-cells = <0>;
		label = "debug_gfx_gated";
		apple,always-on; /* ADT critical */
	};

	ps_nub_gfx_gpio: power-controller@68 {
		compatible = "apple,t6050-pmgr-pwrstate", "apple,t8103-pmgr-pwrstate";
		reg = <0x68 4>;
		#power-domain-cells = <0>;
		#reset-cells = <0>;
		label = "nub_gfx_gpio";
		apple,always-on; /* ADT critical */
	};
};
